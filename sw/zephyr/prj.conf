## CMakeLists.txt
```
cmake_minimum_required(VERSION 3.20.0)

find_package(Zephyr REQUIRED HINTS $ENV{ZEPHYR_BASE})
project(corejack_zephyr_hello)

# CoreJack core/board names for the console banner, passed by the Makefile
# zephyr-build target (mirrors the bare-metal sw/c flow). Defaults keep a direct
# `west build` working without them.
set(COREJACK_CORE "unknown" CACHE STRING "CoreJack core name for the banner")
set(COREJACK_BOARD "unknown" CACHE STRING "CoreJack board name for the banner")

target_sources(app PRIVATE src/main.c)
target_compile_definitions(app PRIVATE
	COREJACK_CORE="${COREJACK_CORE}"
	COREJACK_BOARD="${COREJACK_BOARD}"
)
```

## west.yml
```
manifest:
  remotes:
    - name: zephyrproject-rtos
      url-base: https://github.com/zephyrproject-rtos
  projects:
    - name: zephyr
      remote: zephyrproject-rtos
      # Zephyr v4.4.0
      revision: 4f50f0ba8905f27b2f60123d0ee0934fda6fe134
      west-commands: scripts/west-commands.yml
  self:
    path: corejack
```

## prj.conf
```kconfig
CONFIG_PRINTK=y
CONFIG_SERIAL=y
CONFIG_CONSOLE=y
CONFIG_UART_CONSOLE=y
CONFIG_UART_NS16550=y

CONFIG_TICKLESS_KERNEL=n
CONFIG_TIMESLICING=n

CONFIG_MINIMAL_LIBC=y
CONFIG_MAIN_STACK_SIZE=2048
```

## boards/corejack/corejack_arty_a7_100t/corejack_arty_a7_100t.dtsi
```dts
/*
 * What every core shares on this board. A core's corejack_arty_a7_100t_corejack_<core>.dts
 * includes the RAM split and its CPU description first, then this file.
 */

/ {
	model = "CoreJack on Arty A7-100T";
	compatible = "corejack,corejack-arty-a7-100t";

	chosen {
		zephyr,console = &uart0;
		zephyr,shell-uart = &uart0;
		zephyr,flash = &flash0;
		zephyr,sram = &sram0;
	};
};

&uart0 {
	status = "okay";
	current-speed = <115200>;
	clock-frequency = <25000000>;
};
```

## boards/corejack/corejack_arty_a7_100t/corejack_arty_a7_100t_corejack_cv32e40p.dts
```dts
/dts-v1/;

#include "corejack_arty_a7_100t_ram_split.h"
#include <corejack/corejack_cv32e40p.dtsi>
#include "corejack_arty_a7_100t.dtsi"
```

## boards/corejack/corejack_arty_a7_100t/corejack_arty_a7_100t_corejack_cv32e40s.dts
```dts
/dts-v1/;

#include "corejack_arty_a7_100t_ram_split.h"
#include <corejack/corejack_cv32e40s.dtsi>
#include "corejack_arty_a7_100t.dtsi"
```

## boards/corejack/corejack_arty_a7_100t/corejack_arty_a7_100t_corejack_cv32e40x.dts
```dts
/dts-v1/;

#include "corejack_arty_a7_100t_ram_split.h"
#include <corejack/corejack_cv32e40x.dtsi>
#include "corejack_arty_a7_100t.dtsi"
```

## boards/corejack/corejack_arty_a7_100t/corejack_arty_a7_100t_corejack_cva6.dts
```dts
/dts-v1/;

#include "corejack_arty_a7_100t_ram_split.h"
#include <corejack/corejack_cva6.dtsi>
#include "corejack_arty_a7_100t.dtsi"
```

## boards/corejack/corejack_arty_a7_100t/corejack_arty_a7_100t_corejack_ibex.dts
```dts
/dts-v1/;

#include "corejack_arty_a7_100t_ram_split.h"
#include <corejack/corejack_ibex.dtsi>
#include "corejack_arty_a7_100t.dtsi"
```

## dts/bindings/dma/corejack,idma.yaml
```yaml
# SPDX-License-Identifier: Apache-2.0

description: |
  CoreJack iDMA: the PULP iDMA engine behind its idma_reg32_3d register
  frontend (rtl/platform/soc_idma.sv), with CoreJack's completion flag at
  offset 0xf00 raising a PLIC interrupt. Memory-to-memory copies within RAM
  only. dma-channels sets how many logical channels share the iDMA's single
  transfer queue.

compatible: "corejack,idma"

include: dma-controller.yaml

properties:
  reg:
    required: true

  interrupts:
    required: true

  dma-channels:
    required: true

  "#dma-cells":
    const: 1

dma-cells:
  - channel
```

## src/main.c
```c
#include <zephyr/kernel.h>
#include <zephyr/sys/printk.h>
#if defined(CONFIG_UART_INTERRUPT_DRIVEN)
#include <zephyr/drivers/uart.h>
#endif

/* CoreJack core/board names are injected at build time (see sw/zephyr/CMakeLists.txt
 * and the Makefile zephyr-build target), so the banner is correct for any
 * core/board without per-target preprocessor chains. */
#ifndef COREJACK_CORE
#define COREJACK_CORE "unknown"
#endif
#ifndef COREJACK_BOARD
#define COREJACK_BOARD "unknown"
#endif

#if defined(CONFIG_UART_INTERRUPT_DRIVEN)
static K_SEM_DEFINE(uart_tx_irq, 0, 1);

static void uart_isr(const struct device *dev, void *user_data)
{
	ARG_UNUSED(user_data);

	if (uart_irq_update(dev) && uart_irq_tx_ready(dev)) {
		uart_irq_tx_disable(dev);
		k_sem_give(&uart_tx_irq);
	}
}

/* The console UART's transmitter-empty interrupt reaches the core only through
 * the PLIC (source 1), so taking it proves the external interrupt path - the
 * same event sw/c/plic_smoke uses. */
static bool plic_path_alive(void)
{
	const struct device *uart = DEVICE_DT_GET(DT_CHOSEN(zephyr_console));

	uart_irq_callback_set(uart, uart_isr);
	uart_irq_tx_enable(uart);
	return k_sem_take(&uart_tx_irq, K_MSEC(100)) == 0;
}
#endif

int main(void)
{
	printk("=== CoreJack Zephyr Demo ===\n");
	printk("Target: zephyr\n");
	printk("Core: " COREJACK_CORE "\n");
	printk("Board: " COREJACK_BOARD "\n");
	printk("UART and Zephyr console path are alive.\n");
	k_sleep(K_MSEC(10));
	printk("Machine timer interrupt path is alive.\n");
#if defined(CONFIG_UART_INTERRUPT_DRIVEN)
	if (plic_path_alive()) {
		printk("PLIC external interrupt path is alive.\n");
	} else {
		printk("PLIC external interrupt FAILED: no UART interrupt within 100 ms.\n");
	}
#endif
	/* SERV loops rather than returning from main; other cores return cleanly. */
#if !defined(CONFIG_SOC_COREJACK_SERV)
	return 0;
#endif

	while (1) {
		__asm__ volatile("");
	}
}
```
