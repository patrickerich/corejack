/*
 * What every core shares on this board. A core's corejack_arty_a7_100t_corejack_<core>.dts
 * includes its CPU description first, then this file.
 */

/ {
	model = "CoreJack on Arty A7-100T";
	compatible = "corejack,corejack-arty-a7-100t";

	chosen {
		zephyr,console = &uart0;
		zephyr,shell-uart = &uart0;
		zephyr,flash = &flash0;
		zephyr,sram = &sram0;
	};
};

&uart0 {
	status = "okay";
	current-speed = <115200>;
	clock-frequency = <25000000>;
};
