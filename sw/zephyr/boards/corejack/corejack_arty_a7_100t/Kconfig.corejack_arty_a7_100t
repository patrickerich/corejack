## sw/zephyr/boards/corejack/corejack_arty_a7_100t/Kconfig.corejack_arty_a7_100t
```kconfig
config BOARD_COREJACK_ARTY_A7_100T
	select SOC_COREJACK_IBEX if BOARD_COREJACK_ARTY_A7_100T_COREJACK_IBEX
```

## sw/zephyr/boards/corejack/corejack_arty_a7_100t/board.yml
```yaml
board:
  name: corejack_arty_a7_100t
  full_name: CoreJack on Arty A7-100T
  vendor: corejack
  socs:
    - name: corejack_ibex
    - name: corejack_cv32e40p
    - name: corejack_cv32e40x
    - name: corejack_cv32e40s
    - name: corejack_cva6
    - name: corejack_serv
```

## sw/zephyr/boards/corejack/corejack_axku5/Kconfig.corejack_axku5
```kconfig
config BOARD_COREJACK_AXKU5
	select SOC_COREJACK_IBEX if BOARD_COREJACK_AXKU5_COREJACK_IBEX
	select SOC_COREJACK_CV32E40P if BOARD_COREJACK_AXKU5_COREJACK_CV32E40P
	select SOC_COREJACK_CV32E40X if BOARD_COREJACK_AXKU5_COREJACK_CV32E40X
	select SOC_COREJACK_CV32E40S if BOARD_COREJACK_AXKU5_COREJACK_CV32E40S
	select SOC_COREJACK_CVA6 if BOARD_COREJACK_AXKU5_COREJACK_CVA6
	select SOC_COREJACK_SERV if BOARD_COREJACK_AXKU5_COREJACK_SERV
```

## sw/zephyr/boards/corejack/corejack_axku5/board.yml
```yaml
board:
  name: corejack_axku5
  full_name: CoreJack on AXKU5
  vendor: corejack
  socs:
    - name: corejack_ibex
    - name: corejack_cv32e40p
    - name: corejack_cv32e40x
    - name: corejack_cv32e40s
    - name: corejack_cva6
    - name: corejack_serv
```

## sw/zephyr/boards/corejack/corejack_cv32e40p_axku5/Kconfig.defconfig
```kconfig
if BOARD_COREJACK_CV32E40P_AXKU5

config BOARD
	default "corejack_cv32e40p_axku5"

config MAIN_STACK_SIZE
	default 2048

endif
```

## sw/zephyr/boards/corejack/corejack_cv32e40p_axku5/board.yml
```yaml
board:
  name: corejack_cv32e40p_axku5
  full_name: CoreJack CV32E40P on AXKU5
  vendor: corejack
  socs:
    - name: corejack_rv32
```

## sw/zephyr/boards/corejack/corejack_cv32e40s_axku5/Kconfig.defconfig
```kconfig
if BOARD_COREJACK_CV32E40S_AXKU5

config BOARD
	default "corejack_cv32e40s_axku5"

config MAIN_STACK_SIZE
	default 2048

endif
```

## sw/zephyr/boards/corejack/corejack_cv32e40s_axku5/board.yml
```yaml
board:
  name: corejack_cv32e40s_axku5
  full_name: CoreJack CV32E40S on AXKU5
  vendor: corejack
  socs:
    - name: corejack_rv32
```

## sw/zephyr/boards/corejack/corejack_cv32e40x_axku5/Kconfig.defconfig
```kconfig
if BOARD_COREJACK_CV32E40X_AXKU5

config BOARD
	default "corejack_cv32e40x_axku5"

config MAIN_STACK_SIZE
	default 2048

endif
```

## sw/zephyr/boards/corejack/corejack_cv32e40x_axku5/board.yml
```yaml
board:
  name: corejack_cv32e40x_axku5
  full_name: CoreJack CV32E40X on AXKU5
  vendor: corejack
  socs:
    - name: corejack_rv32
```

## sw/zephyr/boards/corejack/corejack_cva6_axku5/Kconfig.defconfig
```kconfig
if BOARD_COREJACK_CVA6_AXKU5

config BOARD
	default "corejack_cva6_axku5"

config MAIN_STACK_SIZE
	default 2048

endif
```

## sw/zephyr/boards/corejack/corejack_cva6_axku5/board.yml
```yaml
board:
  name: corejack_cva6_axku5
  full_name: CoreJack CVA6 on AXKU5
  vendor: corejack
  socs:
    - name: corejack_rv64
```

## sw/zephyr/boards/corejack/corejack_ibex_arty_a7_100t/Kconfig.defconfig
```kconfig
if BOARD_COREJACK_IBEX_ARTY_A7_100T

config BOARD
	default "corejack_ibex_arty_a7_100t"

config MAIN_STACK_SIZE
	default 2048

endif
```

## sw/zephyr/boards/corejack/corejack_ibex_arty_a7_100t/board.yml
```yaml
board:
  name: corejack_ibex_arty_a7_100t
  full_name: CoreJack Ibex on Arty A7-100T
  vendor: corejack
  socs:
    - name: corejack_rv32
```

## sw/zephyr/boards/corejack/corejack_ibex_axku5/Kconfig.defconfig
```kconfig
if BOARD_COREJACK_IBEX_AXKU5

config BOARD
	default "corejack_ibex_axku5"

config MAIN_STACK_SIZE
	default 2048

endif
```

## sw/zephyr/boards/corejack/corejack_ibex_axku5/board.yml
```yaml
board:
  name: corejack_ibex_axku5
  full_name: CoreJack Ibex on AXKU5
  vendor: corejack
  socs:
    - name: corejack_rv32
```

## sw/zephyr/boards/corejack/corejack_serv_axku5/Kconfig.corejack_serv_axku5
```kconfig
config BOARD_COREJACK_SERV_AXKU5
	select SOC_COREJACK_RV32
	select ARCH_HAS_CUSTOM_CPU_IDLE
	select ARCH_HAS_CUSTOM_CPU_ATOMIC_IDLE
```

## sw/zephyr/boards/corejack/corejack_serv_axku5/Kconfig.defconfig
```kconfig
if BOARD_COREJACK_SERV_AXKU5

config BOARD
	default "corejack_serv_axku5"

config MAIN_STACK_SIZE
	default 2048

endif
```

## sw/zephyr/boards/corejack/corejack_serv_axku5/board.yml
```yaml
board:
  name: corejack_serv_axku5
  full_name: CoreJack SERV on AXKU5
  vendor: corejack
  socs:
    - name: corejack_rv32
```
