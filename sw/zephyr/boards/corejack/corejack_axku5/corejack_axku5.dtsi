/*
 * What every core shares on this board. A core's corejack_axku5_corejack_<core>.dts
 * includes its CPU description first, then this file.
 */

/ {
	model = "CoreJack on AXKU5";
	compatible = "corejack,corejack-axku5";

	chosen {
		zephyr,console = &uart0;
		zephyr,shell-uart = &uart0;
		zephyr,flash = &flash0;
		zephyr,sram = &sram0;
	};
};

&uart0 {
	status = "okay";
	current-speed = <115200>;
	clock-frequency = <25000000>;
};
