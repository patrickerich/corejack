/dts-v1/;

#include <corejack/corejack_ibex.dtsi>

/ {
	model = "CoreJack Ibex on AXKU5";
	compatible = "corejack,corejack-ibex-axku5";

	chosen {
		zephyr,console = &uart0;
		zephyr,shell-uart = &uart0;
		zephyr,flash = &flash0;
		zephyr,sram = &sram0;
	};
};

&uart0 {
	status = "okay";
	current-speed = <115200>;
	clock-frequency = <25000000>;
};
