/dts-v1/;

#include <corejack/corejack_cv32e40p.dtsi>

/ {
	model = "CoreJack CV32E40P on AXKU5";
	compatible = "corejack,corejack-cv32e40p-axku5";

	chosen {
		zephyr,console = &uart0;
		zephyr,shell-uart = &uart0;
		zephyr,flash = &flash0;
		zephyr,sram = &sram0;
	};
};

&uart0 {
	status = "okay";
	current-speed = <115200>;
	clock-frequency = <25000000>;
};
