/dts-v1/;

/*
 * The Artix-7 100T block-RAM budget caps the shared SRAM at 256 KiB; the total
 * comes from the single source of truth (cfg/boards/arty_a7_100t.yaml:
 * memory.ram_bytes), passed in by the build as COREJACK_RAM_BYTES. Only the
 * executable/writable split is board-local: give 192 KiB to the executable
 * (flash) region; sram0 takes the remaining 64 KiB. Defining the split knob
 * before the include lets corejack_rv32_common.dtsi compute both regions.
 */
#define COREJACK_FLASH_BYTES 0x00030000

#include <corejack/corejack_ibex.dtsi>

/ {
	model = "CoreJack Ibex on Arty A7-100T";
	compatible = "corejack,corejack-ibex-arty-a7-100t";

	chosen {
		zephyr,console = &uart0;
		zephyr,shell-uart = &uart0;
		zephyr,flash = &flash0;
		zephyr,sram = &sram0;
	};
};

&uart0 {
	status = "okay";
	current-speed = <115200>;
	clock-frequency = <25000000>;
};
