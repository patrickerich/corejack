## sw/zephyr/boards/corejack/corejack_serv_axku5/corejack_serv_axku5_defconfig
```kconfig
CONFIG_SERIAL=y
CONFIG_CONSOLE=y
CONFIG_UART_CONSOLE=y
CONFIG_UART_NS16550=y
CONFIG_GEN_IRQ_VECTOR_TABLE=y
CONFIG_LINKER_USE_RELAX=n
CONFIG_ROM_START_OFFSET=0x80
CONFIG_SYS_CLOCK_HW_CYCLES_PER_SEC=12500000
```

## sw/zephyr/soc/corejack/corejack_rv32/Kconfig
```kconfig
config SOC_COREJACK_RV32
	select RISCV
	select INCLUDE_RESET_VECTOR
	select RISCV_PRIVILEGED
	select RISCV_HAS_PLIC if DT_HAS_SIFIVE_PLIC_1_0_0_ENABLED
	select RISCV_HAS_PMP
	select XIP
```

## sw/zephyr/soc/corejack/corejack_rv32/Kconfig.soc
```kconfig
# Each core is a Zephyr SoC of its own; they all build on the shared
# CoreJack RV32 platform.
config SOC_COREJACK_RV32
	bool

config SOC_COREJACK_IBEX
	bool
	select SOC_COREJACK_RV32

config SOC_COREJACK_CV32E40P
	bool
	select SOC_COREJACK_RV32

config SOC_COREJACK_CV32E40X
	bool
	select SOC_COREJACK_RV32

config SOC_COREJACK_CV32E40S
	bool
	select SOC_COREJACK_RV32

config SOC_COREJACK_SERV
	bool
	select SOC_COREJACK_RV32

config SOC
	default "corejack_ibex" if SOC_COREJACK_IBEX
	default "corejack_cv32e40p" if SOC_COREJACK_CV32E40P
	default "corejack_cv32e40x" if SOC_COREJACK_CV32E40X
	default "corejack_cv32e40s" if SOC_COREJACK_CV32E40S
	default "corejack_serv" if SOC_COREJACK_SERV
```

## sw/zephyr/soc/corejack/corejack_rv64/Kconfig
```kconfig
config SOC_COREJACK_RV64
	select RISCV
	select INCLUDE_RESET_VECTOR
	select RISCV_PRIVILEGED
	select RISCV_HAS_PMP
	select XIP
```
